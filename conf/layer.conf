## conf/layer.conf
```bitbake
# We have a conf and classes directory, add to BBPATH
BBPATH .= ":${LAYERDIR}"

# We have recipes-* directories, add to BBFILES
BBFILES += "${LAYERDIR}/recipes-*/*/*.bb \
            ${LAYERDIR}/recipes-*/*/*.bbappend"

BBFILE_COLLECTIONS += "meta-pb"
BBFILE_PATTERN_meta-pb = "^${LAYERDIR}/"
BBFILE_PRIORITY_meta-pb = "6"

LAYERDEPENDS_meta-pb = "core"
LAYERSERIES_COMPAT_meta-pb = "dunfell"
```

## conf/machine/pocketbeagle.conf
```bitbake
include conf/machine/include/ti33x.inc

PREFERRED_PROVIDER_virtual/kernel = "linux-pocketbeagle"

SPL_BINARY = "MLO"
PREFERRED_PROVIDER_virtual/bootloader = "u-boot"
PREFERRED_PROVIDER_u-boot = "u-boot"
```
